## config/boards/shields/mignice/Kconfig.defconfig
```kconfig
# Copyright (c) 2020 FAMIG
# SPDX-License-Identifier: MIT

if SHIELD_MIGNICE

config ZMK_KEYBOARD_NAME
    default "MIGNICE"

endif
```

## config/boards/shields/mignice/Kconfig.shield
```kconfig
# Copyright (c) 2020 FAMIG
# SPDX-License-Identifier: MIT

config SHIELD_MIGNICE
    def_bool $(shields_list_contains,mignice)
```
